## boards/shields/sofle/Kconfig.defconfig
```kconfig
#-----------------------------------------------------
if SHIELD_SOFLE_LEFT

config ZMK_SPLIT_ROLE_CENTRAL
    default y

config I2C
    default y

config INPUT_TPS43
    default y
    
endif #SHIELD_SOFLE_LEFT
#-----------------------------------------------------
if SHIELD_SOFLE_RIGHT


endif #SHIELD_SOFLE_RIGHT
#-----------------------------------------------------

if SHIELD_SOFLE_LEFT || SHIELD_SOFLE_RIGHT

config ZMK_POINTING
    default y

endif #SHIELD_SOFLE_LEFT || SHIELD_SOFLE_RIGHT
```

## config/west.yml
```yaml
manifest:
  defaults:
    revision: v0.3
  remotes:
    - name: zmkfirmware
      url-base: https://github.com/zmkfirmware
      ####
    #- name: stelmakhdigital
    #  url-base: https://github.com/stelmakhdigital
    - name: geeksville
      url-base: https://github.com/geeksville
  projects:
    - name: zmk
      remote: zmkfirmware
      revision: v0.3
      import: app/west.yml
      ####
    #- name: zmk_driver_azoteq
    #  remote: stelmakhdigital
    #  revision: master
    - name: zmk_driver_azoteq
      remote: geeksville
      revision: master
  self:
    path: config
```
